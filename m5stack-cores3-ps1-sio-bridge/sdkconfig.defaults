## m5stack-cores3-ps1-sio-bridge/sdkconfig.defaults
```kconfig
CONFIG_BT_ENABLED=y
CONFIG_BT_BLUEDROID_ENABLED=n
CONFIG_BT_NIMBLE_ENABLED=y
CONFIG_BT_NIMBLE_ROLE_CENTRAL=y
CONFIG_BT_NIMBLE_ROLE_PERIPHERAL=y
CONFIG_BT_NIMBLE_MAX_CONNECTIONS=1
CONFIG_BT_NIMBLE_HS_FLOW_CTRL=y
CONFIG_ESP_HIDH_ENABLED=y
CONFIG_USB_SERIAL_JTAG_ENABLED=y
```
